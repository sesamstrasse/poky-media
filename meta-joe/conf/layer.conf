## meta-joe/conf/layer.conf
```bitbake
# We have a conf and classes directory, add to BBPATH
BBPATH .= ":${LAYERDIR}"

# We have recipes-* directories, add to BBFILES
BBFILES += "${LAYERDIR}/recipes-*/*/*.bb \
            ${LAYERDIR}/recipes-*/*/*.bbappend"

BBFILE_COLLECTIONS += "joe"
BBFILE_PATTERN_joe := "^${LAYERDIR}/"
BBFILE_PRIORITY_joe = "7"

PREFERRED_PROVIDER_jpeg ?= "jpeg"
PREFERRED_PROVIDER_jpeg-native ?= "jpeg-native"
```

## meta-yocto/conf/bblayers.conf.sample
```bitbake
# LAYER_CONF_VERSION is increased each time build/conf/bblayers.conf
# changes incompatibly
LCONF_VERSION = "6"

BBPATH = "${TOPDIR}"
BBFILES ?= ""

BBLAYERS ?= " \
  ##COREBASE##/meta \
  ##COREBASE##/meta-yocto \
  ##COREBASE##/meta-yocto-bsp \
  ##COREBASE##/meta-intel \
  ##COREBASE##/meta-intel/meta-cedartrail \
  ##COREBASE##/meta-openembedded/meta-oe \
  ##COREBASE##/meta-joe \
  "
```
